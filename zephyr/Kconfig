## zephyr/Kconfig
```kconfig
# Copyright 2026 Arm Limited and/or its affiliates.
# SPDX-License-Identifier: Apache-2.0

menuconfig CMSIS_EXECUTORCH
	bool "CMSIS-ExecuTorch runtime and selected operators"
	depends on CPP
	depends on STD_CPP_VERSION >= 201703
	depends on !EXECUTORCH
	select REQUIRES_FULL_LIBCPP
	help
	  Compile runtime and selected operator sources from the installed
	  ExecuTorch Zephyr module, using pre-generated headers supplied here.
	  Keep CONFIG_EXECUTORCH disabled: its upstream build is not used.
	  No host tools are compiled and no operator code generator is run.
	  Enable C++ and select C++17 or a newer standard in the application.

if CMSIS_EXECUTORCH

rsource "Kconfig.components"

rsource "Kconfig.operators"

config CMSIS_EXECUTORCH_EMBEDDED_MODULE
	bool "Arm EmbeddedModule facade"
	default y
	select CMSIS_EXECUTORCH_RUNTIME
	help
	  Include arm::embedded::EmbeddedModule from this project's src directory.
	  The caller supplies a data loader and memory allocators for its model.

rsource "Kconfig.executorch"

endif # CMSIS_EXECUTORCH
```

## zephyr/Kconfig.components
```kconfig
# Copyright 2026 Arm Limited and/or its affiliates.
# SPDX-License-Identifier: Apache-2.0
# Generated by update_zephyr.py from PyTorch::ExecuTorch@1.5.1.

# One selection per non-operator pack component.

config CMSIS_EXECUTORCH_RUNTIME
	bool "Runtime"
	default y
	help
	  ExecuTorch Core Runtime - Required for all ExecuTorch applications
	  Compile runtime/backend/interface.cpp.
	  Compile runtime/core/device_allocator.cpp.
	  Compile runtime/core/device_memory_buffer.cpp.
	  Compile runtime/core/evalue.cpp.
	  Compile runtime/core/exec_aten/util/tensor_shape_to_c_string.cpp.
	  Compile runtime/core/exec_aten/util/tensor_util_portable.cpp.
	  Compile runtime/core/portable_type/tensor_impl.cpp.
	  Compile runtime/core/tag.cpp.
	  Compile runtime/core/tensor_layout.cpp.
	  Compile runtime/executor/method.cpp.
	  Compile runtime/executor/method_meta.cpp.
	  Compile runtime/executor/program.cpp.
	  Compile runtime/executor/program_validation.cpp.
	  Compile runtime/executor/pte_data_map.cpp.
	  Compile runtime/executor/tensor_parser_exec_aten.cpp.
	  Compile runtime/executor/tensor_parser_portable.cpp.
	  Compile runtime/kernel/operator_registry.cpp.
	  Compile runtime/platform/abort.cpp.
	  Compile runtime/platform/default/zephyr.cpp.
	  Compile runtime/platform/log.cpp.
	  Compile runtime/platform/platform.cpp.
	  Compile runtime/platform/profiler.cpp.
	  Compile runtime/platform/runtime.cpp.
	  Compile schema/extended_header.cpp.
	  Compile kernels/quantized/cpu/embeddingxb.cpp.
	  Use the upstream Zephyr PAL in place of the pack minimal PAL.

config CMSIS_EXECUTORCH_KERNEL_UTILS
	bool "Kernel Utils"
	select CMSIS_EXECUTORCH_RUNTIME
	help
	  ExecuTorch Kernel Registration Utilities
	  Compile kernels/portable/cpu/util/activation_ops_util.cpp.
	  Compile kernels/portable/cpu/util/advanced_index_util.cpp.
	  Compile kernels/portable/cpu/util/arange_util.cpp.
	  Compile kernels/portable/cpu/util/broadcast_util.cpp.
	  Compile kernels/portable/cpu/util/copy_ops_util.cpp.
	  Compile kernels/portable/cpu/util/delinearize_index.cpp.
	  Compile kernels/portable/cpu/util/distance_util.cpp.
	  Compile kernels/portable/cpu/util/dtype_util.cpp.
	  Compile kernels/portable/cpu/util/grid_sampler_2d_util.cpp.
	  Compile kernels/portable/cpu/util/index_util.cpp.
	  Compile kernels/portable/cpu/util/kernel_ops_util.cpp.
	  Compile kernels/portable/cpu/util/matmul_ops_util.cpp.
	  Compile kernels/portable/cpu/util/normalization_ops_util.cpp.
	  Compile kernels/portable/cpu/util/padding_util.cpp.
	  Compile kernels/portable/cpu/util/reduce_util.cpp.
	  Compile kernels/portable/cpu/util/repeat_util.cpp.
	  Compile kernels/portable/cpu/util/select_copy_util.cpp.
	  Compile kernels/portable/cpu/util/slice_util.cpp.
	  Compile kernels/portable/cpu/util/stack_util.cpp.
	  Compile kernels/portable/cpu/util/upsample_util.cpp.
	  Compile kernels/portable/cpu/pattern/unary_ufunc_realhbbf16_to_bool.cpp.
	  Compile kernels/portable/cpu/pattern/unary_ufunc_realhbbf16_to_floathbf16.cpp.
	  Compile kernels/portable/cpu/pattern/unary_ufunc_realhbf16.cpp.

config CMSIS_EXECUTORCH_EXTENSION_TENSOR
	bool "Extension Tensor"
	select CMSIS_EXECUTORCH_RUNTIME
	help
	  ExecuTorch Tensor Extension - TensorPtr / make_tensor_ptr utilities
	  Compile extension/tensor/tensor_ptr.cpp.
	  Compile extension/tensor/tensor_ptr_maker.cpp.

config CMSIS_EXECUTORCH_KERNEL_REGISTRATION
	bool "Kernel Registration"
	default y
	select CMSIS_EXECUTORCH_KERNEL_UTILS
	help
	  ExecuTorch Kernel Registration - Registers all selected operators
	  Use pre-generated Zephyr registration guards for selected operators.
	  Disable when the application supplies its own registration.

config CMSIS_EXECUTORCH_BACKEND_ETHOS_U
	bool "Backend EthosU"
	depends on CPU_CORTEX_M && ETHOS_U
	select CMSIS_EXECUTORCH_RUNTIME
	help
	  ExecuTorch Ethos-U NPU Backend - Cortex-M host (bare-metal). Hardware acceleration for Ethos-U55/U65
	  Compile backends/arm/runtime/EthosUBackend.cpp.
	  Compile backends/arm/runtime/EthosUBackend_Cortex_M.cpp.
	  Compile backends/arm/runtime/EthosUBackend_IoMemcpy.cpp.
	  Compile backends/arm/runtime/VelaBinStream.cpp.
	  Enable the Zephyr Ethos-U driver and configure the NPU for your board.
```

## zephyr/Kconfig.executorch
```kconfig
# Copyright 2026 Arm Limited and/or its affiliates.
# SPDX-License-Identifier: Apache-2.0

# The upstream zephyr/Kconfig gates its options on EXECUTORCH, which also
# enables its CMake build. Keep local symbols for our direct-source build.
# Review defaults and macro semantics against the pinned pack when upgrading.
menu "ExecuTorch runtime settings"

config CMSIS_EXECUTORCH_LOG_ENABLED
	bool "ExecuTorch diagnostic messages"
	default y
	help
	  Set ET_LOG_ENABLED to 1 or 0 for runtime diagnostic messages through
	  ExecuTorch's existing Zephyr PAL.

choice CMSIS_EXECUTORCH_LOG_LEVEL
	prompt "Minimum compiled log severity"
	depends on CMSIS_EXECUTORCH_LOG_ENABLED
	default CMSIS_EXECUTORCH_LOG_LEVEL_INFO
	help
	  Messages below this severity are excluded at compile time through
	  ET_MIN_LOG_LEVEL. The values match ExecuTorch's LogLevel enum.

config CMSIS_EXECUTORCH_LOG_LEVEL_DEBUG
	bool "Debug"

config CMSIS_EXECUTORCH_LOG_LEVEL_INFO
	bool "Info"

config CMSIS_EXECUTORCH_LOG_LEVEL_ERROR
	bool "Error"

config CMSIS_EXECUTORCH_LOG_LEVEL_FATAL
	bool "Fatal"

endchoice

config CMSIS_EXECUTORCH_MIN_LOG_LEVEL
	string
	default "Debug" if CMSIS_EXECUTORCH_LOG_LEVEL_DEBUG
	default "Error" if CMSIS_EXECUTORCH_LOG_LEVEL_ERROR
	default "Fatal" if CMSIS_EXECUTORCH_LOG_LEVEL_FATAL
	default "Info"

config CMSIS_EXECUTORCH_PROGRAM_VERIFICATION
	bool "Verify the program FlatBuffer when loading"
	default y
	help
	  Set ET_ENABLE_PROGRAM_VERIFICATION to 1 or 0. The verification mode
	  requested when loading the program still determines whether it is run.

config CMSIS_EXECUTORCH_ENUM_STRINGS
	bool "Include enum names in diagnostics"
	default y
	help
	  Set ET_ENABLE_ENUM_STRINGS to 1 or 0. Disable to omit enum name
	  strings from runtime headers and reduce code size.

config CMSIS_EXECUTORCH_DEPRECATED_CONSTANT_BUFFER
	bool "Support the deprecated constant_buffer model format"
	default y
	help
	  Set ET_ENABLE_DEPRECATED_CONSTANT_BUFFER to 1 or 0. The pack sources
	  enable this compatibility path by default; disable for models that
	  use the newer constant segment format exclusively.

config CMSIS_EXECUTORCH_MAX_INSTRUCTIONS
	int "Maximum instructions per method execution"
	range 1 2147483647
	default 10000000
	help
	  Set ET_MAX_INSTRUCTIONS, the execution limit that prevents malformed
	  programs from looping indefinitely. The value must be positive.

config CMSIS_EXECUTORCH_EVENT_TRACER
	bool "Enable event tracer hooks"
	help
	  Define ET_EVENT_TRACER_ENABLED to compile the runtime's event tracer
	  hooks. Supply an executorch::runtime::EventTracer implementation when
	  loading the method. This does not include ETDump or its code generators.
	  The macro is left undefined when disabled, as upstream uses #ifdef.

config CMSIS_EXECUTORCH_OP_REGISTRY_DEBUG
	bool "Enable operator registry debug helpers"
	help
	  Define ET_OP_REGISTRY_DEBUG to include the registry's debug stream
	  operators. The macro is left undefined when disabled.

config CMSIS_EXECUTORCH_PROFILING
	bool "Enable the built-in profiler"
	help
	  Define PROFILING_ENABLED to activate the runtime's performance and
	  memory profiling macros. The macro is left undefined when disabled.
	  This profiler uses fixed buffers sized by the following settings and
	  is independent of the EventTracer interface.

if CMSIS_EXECUTORCH_PROFILING

config CMSIS_EXECUTORCH_MAX_PROFILE_EVENTS
	int "Performance events per profiling block"
	range 1 65535
	default 1024
	help
	  Set MAX_PROFILE_EVENTS. Increasing this increases the profiler buffer.

config CMSIS_EXECUTORCH_MAX_MEM_PROFILE_EVENTS
	int "Memory allocation events per profiling block"
	range 1 65535
	default 1024
	help
	  Set MAX_MEM_PROFILE_EVENTS. Increasing this increases the profiler buffer.

config CMSIS_EXECUTORCH_MEM_PROFILE_MAX_ALLOCATORS
	int "Allocators per profiling block"
	range 1 65535
	default 32
	help
	  Set MEM_PROFILE_MAX_ALLOCATORS.

config CMSIS_EXECUTORCH_MAX_PROFILE_BLOCKS
	int "Profiling blocks"
	range 1 65535
	default 2
	help
	  Set MAX_PROFILE_BLOCKS. The profiler allocates one buffer per block.

endif # CMSIS_EXECUTORCH_PROFILING

config CMSIS_EXECUTORCH_ETHOS_U_PER_DELEGATE_PROFILING
	bool "Ethos-U per-delegate profiling callbacks"
	depends on CMSIS_EXECUTORCH_BACKEND_ETHOS_U
	help
	  Define ET_ARM_ETHOSU_PER_DELEGATE_PROFILING to include the Ethos-U
	  delegate begin/end callbacks. The application can override the backend's
	  weak callbacks. The macro is left undefined when disabled.

config CMSIS_EXECUTORCH_EXTRA_KERNEL_SLOTS
	int "Additional slots for application-defined kernels"
	range 0 65535
	default 0
	help
	  MAX_KERNEL_NUM is sized automatically for the selected operator
	  families. Reserve extra slots here for application-defined kernels.

endmenu
```
